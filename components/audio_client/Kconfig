## components/audio_client/Kconfig
```kconfig
config ENABLE_SIP_AUDIO_CLIENT
    bool "Enable audio functionality"
    help
        Select this if you want audio support (e.g. voice).

config ENABLE_SIP_AUDIO_CODEC_G711
    bool "Enable G711 audio codec"
    depends on ENABLE_SIP_AUDIO_CLIENT
    help
        Select this to support g711 audio codec
```

## main/Kconfig.actuator
```kconfig
config ACTUATOR_ENABLED
    bool "Actuator enabled"
        help
            An Actuator can be enabled to trigger a gpio when a button is pressed during the call.

if ACTUATOR_ENABLED

config ACTUATOR_OUTPUT_GPIO
    int "Actuator output GPIO number"
        range 0 34
        default 13
        help
            GPIO number (IOxx) to trigger the actuator for e.g. a door opener
            GPIOs 35-39 are input-only so cannot be used as outputs.

config ACTUATOR_ACTIVE_HIGH
    bool "Actuator output active high type"
        default y
        help
            This is about the hardware configuration of your setup. Active high (true) means the actuator is set to true/high when it is triggered.
            Active low (false) means the actuator is set to false/low when it is triggered.

config ACTUATOR_SWITCHING_DURATION
    int "Actuator switching duration in milliseconds"
        range 500 10000
        default 3000
        help
            This is the duration in milliseconds, the actuator is activated.

config ACTUATOR_PHONE_BUTTON
    string "Actuator phone button character"
        default "#"
        help
            This is a single character which can be pressed to activated the actuator during the call.
            Note: Currently only one character can be used.

endif
```

## main/Kconfig.projbuild
```kconfig
menu "SipCall Configuration"

config WIFI_SSID
    string "WiFi SSID"
    default "myssid"
    help
	SSID (network name) for the example to connect to.

config WIFI_PASSWORD
    string "WiFi Password"
    default "mypassword"
    help
	WiFi password (WPA or WPA2) for the example to use.

choice POWER_SAVE_MODE
    prompt "power save mode"
    default POWER_SAVE_NONE
    help
	Power save mode for the esp32 to use.

config POWER_SAVE_NONE
    bool "none"
config POWER_SAVE_MODEM_MIN
    bool "Modem-sleep minimum power save mode"
config POWER_SAVE_MODEM_MAX
    bool "Modem-sleep maximum power save mode"
endchoice

config BELL_INPUT_GPIO
    int "Bell input GPIO number"
        range 0 39
        default 9 if IDF_TARGET_ESP32C3
        default 0
        help
                GPIO number (IOxx) to read the bell state from.
                Some GPIOs are used for other purposes (flash connections, etc.) and cannot be used.
                GPIO 0 is also the boot pin on ESP32, so the BOOT button can be used for testing.
                GPIO 9 is used on ESP-C3-32S-Kit as BOOT button.

rsource 'Kconfig.actuator'

config RING_DURATION
    int "Ring duration in milliseconds"
        range 1000 30000
        default 7000
        help
                This is the maximum duration, the called phone rings.
		In reality, this phone rings for a shorter duration, because there is a delay, between
		the SIP ring request, the ACK from the SIP server and the actual ringing of the phone.

choice
	prompt "SIP Server Address"

config SIP_SERVER_IS_GATEWAY_IP
       bool "The SIP server is running on the default gateway"
       help
		This is the case if you have a default setup where
		the router also contains the SIP server, e.g. a FritzBox.

		If this option is activated, the default gateway address that
		is sent from the dhcp server to this esp32 is used as the SIP
		server ip address.       
       
config SIP_SERVER_FIXED_IP
       bool "The SIP server has a fixed IP address"

endchoice

config SIP_SERVER_IP
    string "SIP Server IP" if SIP_SERVER_FIXED_IP
        default "192.168.179.1"
        help
                SIP Server IP to connect to.

config SIP_SERVER_PORT
        string "SIP Server Port"
        default "5060"
        help
                SIP Server port to connect to.
                Should be chosen not to conflict with any other port used
                on the system.

config SIP_USER
    string "SIP Username"
        default "620"
        help
                SIP Username to log into the SIP server.

config SIP_PASSWORD
    string "SIP User Password"
        default "secret"
        help
                Password for the given SIP User to log into the SIP server.

config LOCAL_IP
    string "Local IP"
        default "192.168.179.30"
        help
                IP address of the ESP32.

		This is overwritten with the assigned IP address from the DHCP server.	

                See README.md for details.

config CALL_TARGET_USER
    string "Call Target User"
        default "**611"
        help
                This target user on the local sip server is called if the event happens

                See README.md for details.

config CALLER_DISPLAY_MESSAGE
    string "Caller Display Message"
        default "Türklingel"
        help
                This message is shown on the called device.

                See README.md for details.

config HTTP_SERVER
       bool "Include HTTP server"
       default y
       select HTTPD_WS_SUPPORT
       help
         This enables/disables the inclusion of the http server.

config MDNS_SERVER
       bool "Provide own hostname via mDNS"
       default y if HTTP_SERVER
       help
         This enables mDNS server on the ESP32

config MDNS_HOSTNAME
       string "Own hostname for mDNS"
       depends on MDNS_SERVER
       default "sip-call"
       help
         The hostname that is advertised via mDNS. The esp32 is reachable
	 from the browser via http://sip-call.local.

config MDNS_INSTANCE
       string "Instance name for mDNS"
       depends on MDNS_SERVER
       default "ESP32 SIP Call"
       help
         The instance name used for mDNS.

endmenu
```

## sdkconfig.defaults
```kconfig
CONFIG_ESP_MAIN_TASK_STACK_SIZE=16000

# reset on watchdog error
CONFIG_ESP_TASK_WDT_PANIC=y

# set custom partition layout based on Single Factory app, no OTA
# CONFIG_PARTITION_TABLE_SINGLE_APP is not set
CONFIG_PARTITION_TABLE_CUSTOM=y

CONFIG_ESPTOOLPY_FLASHSIZE_4MB=y
CONFIG_HTTPD_WS_SUPPORT=y
```
